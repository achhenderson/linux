## fs/fuse/Kconfig
```kconfig
# SPDX-License-Identifier: GPL-2.0-only
config FUSE_FS
	tristate "FUSE (Filesystem in Userspace) support"
	depends on IO_URING
	select FS_POSIX_ACL
	help
	  With FUSE it is possible to implement a fully functional filesystem
	  in a userspace program.

	  This provides the fusex filesystem, which talks to its server only
	  through io-uring and leaves caching to the server.

	  If you want to develop a userspace FS, or if you want to use
	  a filesystem based on FUSE, answer Y or M.
```
